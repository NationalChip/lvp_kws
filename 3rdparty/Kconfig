## app/iic_test/Kconfig
```kconfig
# Voice Signal Preprocess
# Copyright (C) 2001-2020 NationalChip Co., Ltd
# ALL RIGHTS RESERVED!
#
# Kconfig:
#
#---------------------------------------------------------------------------------#

if LVP_APP_IIC_TEST
    choice
        prompt "IIC Mode Choice"
        default MASTER

        config LVP_APP_IIC_TEST_MASTER
            bool "IIC MASTER"

        config LVP_APP_IIC_TEST_SLAVE
            bool "IIC SLAVE"

    endchoice
endif
```

## app/lvp_app_kws_state_demo/Kconfig
```kconfig
# Voice Signal Preprocess
# Copyright (C) 2001-2021 NationalChip Co., Ltd
# ALL RIGHTS RESERVED!
#
# Kconfig:
#
#---------------------------------------------------------------------------------#

if LVP_APP_KWS_STATE_DEMO

    choice
        prompt "MCU Work Low Frequency When MCU Is Not Wake:"
        default MCU_LOW_FREQUENCY_8M

        config MCU_LOW_FREQUENCY_4M
            bool "4M"

        config MCU_LOW_FREQUENCY_8M
            bool "8M"

        config MCU_LOW_FREQUENCY_12M
            bool "12M"

        config MCU_LOW_FREQUENCY_24M
            bool "24M"
    endchoice

    config APP_VC_HAS_LED
        bool "has led"
        default n

    if APP_VC_HAS_LED
        config APP_VC_KWS_LED_PIN_ID
            int "KWS LED GPIO"
            default 3
    endif

endif
```

## app/voice_controller/Kconfig
```kconfig
# Voice Signal Preprocess
# Copyright (C) 2001-2020 NationalChip Co., Ltd
# ALL RIGHTS RESERVED!
#
# Kconfig:
#
#---------------------------------------------------------------------------------#

if LVP_APP_VOICE_CONTROLLER

    config APP_VC_UART
        bool "by uart"

    if APP_VC_UART
        config APP_VC_UART_PORT
        int "vc uart port"
        default 0
        range 0 1
    endif

    config APP_VC_HW_I2C
        bool "by HW I2C"
        select BOARD_HAS_HW_I2C

    config APP_VC_HAS_LED
        bool "has led"
        default n

    if APP_VC_HAS_LED
        config APP_VC_LED_1_PIN_ID
            int "LED 1 GPIO"
            default 3
        config APP_VC_LED_2_PIN_ID
            int "LED 2 GPIO"
            default 4
    endif


    config APP_VC_HAS_MESSAGE_NOTIFY_PIN
        bool "has notify pin"
        default y

    if APP_VC_HAS_MESSAGE_NOTIFY_PIN
        config APP_VC_MESSAGE_NOTIFY_PIN_ID
        int "notify pin ID"
        default 2
    endif

    choice
        prompt "uart message config "
        config APP_VC_UART_MESSAGE_QUERY_SUPPORTED
            bool "Uart message query supported"

        config APP_VC_UART_MESSAGE_NOTIFY_SUPPORTED
            bool "Uart message notify supported"
    endchoice

endif
```

## app/voice_controller_v2/Kconfig
```kconfig
# Voice Signal Preprocess
# Copyright (C) 2001-2020 NationalChip Co., Ltd
# ALL RIGHTS RESERVED!
#
# Kconfig:
#
#---------------------------------------------------------------------------------#

if LVP_APP_VOICE_CONTROLLER_V2

    config APP_VC2_UART
        bool "by uart"

    config APP_VC2_HW_I2C
        bool "by HW I2C"
        select BOARD_HAS_HW_I2C

    config APP_VC2_HAS_MESSAGE_NOTIFY_PIN
        bool "has notify pin"
        default y

    if APP_VC2_HAS_MESSAGE_NOTIFY_PIN
        config APP_VC2_MESSAGE_NOTIFY_PIN_ID
        int "notify pin ID"
        default 2
    endif

    config UART_AWAKE
        bool "has uart awake"
        default N

    if UART_AWAKE
        choice
            prompt "port"
            config UART0_AWAKE
                bool "UART0"

            config UART1_AWAKE
                bool "UART1"
        endchoice
    endif

    choice
        prompt "uart message config"
        config APP_VC2_UART_MESSAGE_QUERY_SUPPORTED
            bool "Uart message query supported"

        config APP_VC2_UART_MESSAGE_NOTIFY_SUPPORTED
            bool "Uart message notify supported"
    endchoice

endif
```

## app/voice_player/Kconfig
```kconfig
# Voice Signal Preprocess
# Copyright (C) 2001-2020 NationalChip Co., Ltd
# ALL RIGHTS RESERVED!
#
# Kconfig:
#
#---------------------------------------------------------------------------------#

if LVP_APP_VOICE_PLAYER

choice
prompt "use solution:"
config PLAY_MIC_DATA
    bool "play voice from mic"
config PLAY_WAV_DATA
    bool "play wav when kws_value == 100"
config PLAY_OPUS_DATA
    bool "play opus when kws_value == 100"
config YILIAN_FAN_SOLUTION
    bool "yilian fan solution"
endchoice

endif
```

## app/xip_demo/Kconfig
```kconfig
# Voice Signal Preprocess
# Copyright (C) 2001-2020 NationalChip Co., Ltd
# ALL RIGHTS RESERVED!
#
# Kconfig:
#
#---------------------------------------------------------------------------------#

if LVP_APP_XIP_DEMO

    config LVP_APP_XIP_DEMO_RODATA
        bool ".xip.rodata"
        default y
endif
```

## arch/Kconfig
```kconfig
# Voice Signal Preprocess
# Copyright (C) 2001-2020 NationalChip Co., Ltd
# ALL RIGHTS RESERVED!
#
# Kconfig: Chipset setting
#

config MCU_ARCH
    string
    default "csky" if (GX8002)
    help
      This option should contain the architecture name to build the
      appropriate arch/cpu/<CONFIG_MCU_ARCH> directory.
      All the architectures should specify this option correctly.

config MCU_TYPE
    string
    default "ck804" if (GX8002)
    help
      This option should contain the CPU name to build the correct
      arch/cpu/<CONFIG_MCU_TYPE> directory.

      This is optional.  For those targets without the CPU directory,
      leave this option empty.

config MCU_LINK_SCRIPT
    string
    help
      This option should contain the MCU Link Script path.

config SOC_MODEL
    string
    default "grus" if GX8002
    help
      This option should contain the SoC name to build the directory
      arch/soc/<CONFIG_SOC_MODEL>.

      This is optional.  For those targets without the SoC directory,
      leave this option empty.

config SOC_SRAM_SIZE_KB
    int
    help
      This option describe the SRAM size in SOC.

source "mcu/arch/soc/grus/Kconfig"
```

## arch/soc/grus/Kconfig
```kconfig
if ARCH_GRUS

choice
	prompt "grus board select"
	optional
	default TARGET_GRUS_FPGA_V1

config TARGET_GRUS_BOOT
	bool "GRUS BOOT"

config TARGET_GRUS_BBT_V1
	bool "GRUS BBT Device Board V1.0"

config TARGET_GRUS_FPGA_V1
	bool "GRUS FPGA Device Board V1.0"

config TARGET_GRUS_GX8002T_DEV_V1
	bool "GRUS GX8002T DEV Device Board V1.0"

config TARGET_GRUS_GX8002_LOWPOWER_V1
	bool "GRUS GX8002 Lowpower Device Board V1.0"

config TARGET_GRUS_GX8002_LVP_V1
	bool "GRUS GX8002 LVP Solution Device Board V1.0"

endchoice

config SYS_SOC
	default "grus"

source "board/nationalchip/grus_boot/Kconfig"
source "board/nationalchip/grus_bbt_1v/Kconfig"
source "board/nationalchip/grus_fpga_1v/Kconfig"
source "board/nationalchip/grus_gx8002t_dev_1v/Kconfig"
source "board/nationalchip/grus_gx8002_lowpower_1v/Kconfig"
source "board/nationalchip/grus_gx8002_lvp_1v/Kconfig"

endif
```

## boards/Kconfig
```kconfig
# Voice Signal Preprocess
# Copyright (C) 2001-2020 NationalChip Co., Ltd
# ALL RIGHTS RESERVED!
#
# Kconfig: Board related config
#
#---------------------------------------------------------------------------------#
# Public Board Values

config BOARD_VENDOR
    string
    help
      This option should contain the vendor name of the target board.
      If it is set and
      board/<CONFIG_SYS_VENDOR>/common/Makefile exists, the vendor common
      directory is compiled.
      If CONFIG_SYS_BOARD is also set, the sources under
      board/<CONFIG_SYS_VENDOR>/<CONFIG_SYS_BOARD> directory are compiled.

      This is optional.  For those targets without the vendor directory,
      leave this option empty.

config BOARD_MODEL
    string
    help
      This option should contain the name of the target board.
      If it is set, either board/<CONFIG_SYS_VENDOR>/<CONFIG_SYS_BOARD>
      or board/<CONFIG_SYS_BOARD> directory is compiled depending on
      whether CONFIG_SYS_VENDOR is set or not.

      This is optional.  For those targets without the board directory,
      leave this option empty.

config SYS_CONFIG_NAME
    string
    help
      This option should contain the base name of board header file.
      The header file include/configs/<CONFIG_SYS_CONFIG_NAME>.h
      should be included from include/config.h.

config BOARD_SUPPORT_MULTIBOOT
    bool
    help
      Declare whether the board supports Multiboot. If y, board should implement
      BootBoardGetImageInfo() in boot_board.c

config BOARD_SUPPORT_STANDBY
    bool
    help
      Declare whether the board supports suspend. If y, board should implement
      BoardSuspend and BoardResume in misc_board.c

config BOARD_MIC_NUM
    int

config LVP_BUFFER_HAS_MIC
    bool

config LVP_BUFFER_HAS_REF
    bool

config LVP_BUFFER_HAS_FFT
    bool

config LVP_BUFFER_HAS_LOGFBANK
    bool

config LVP_BUFFER_HAS_OUTPUT
    bool

config LVP_HAS_STANDBY
    bool

config LVP_HAS_G_SENSOR
    bool
#---------------------------------------------------------------------------------#

choice
    prompt "Vendor selects:"
    default BOARD_VENDOR_NATIONALCHIP

    source "boards/*/vendor.name"

endchoice

choice
    prompt "Board selects:"
    default BOARD_GX8002_FPGA_V1

    source "boards/*/*/board.name"

endchoice

source "boards/*/*/Kconfig"

menu "Microphone Type selects:"

    config TYPE_DMIC
        bool "DMIC"
        depends on !BOARD_NO_DMIC
    if TYPE_DMIC
        config TYPE_DMIC_TRACK
        int "DMIC Number"
        default 1
        range 1 2

        config DMIC_EXCHANGE_CHANNEL
            bool "DMIC Exchange channel"
            default n
        config DMIC_PDM_SLAVE
            bool "DMIC by PDM Slave"
            select BOARD_PDM_SLAVE
            default n
    endif

    config TYPE_AMIC
        bool "AMIC"
        default y
    if TYPE_AMIC
        config TYPE_AMIC_TRACK
        int "AMIC Number"
        default 1
        range 1 2
    endif

    config TYPE_I2S_MASTER
        bool "I2S_MIC_MASTER"
        depends on BOARD_HAS_AIN_I2S_MASTER

    config TYPE_I2S_SLAVE
        bool "I2S_MIC_SLAVE"
        depends on BOARD_HAS_AIN_I2S_SLAVE

    if TYPE_I2S_SLAVE || TYPE_I2S_MASTER
        config TYPE_I2S_TRACK
        int "I2S MIC Number"
        default 1
        range 1 2

        config I2S_EXCHANGE_CHANNEL
            bool "I2S Exchange channel"
            default n
    endif

    config ENABLE_HARDWARE_FFT
        bool "Enable HardWare FFT"
        default n

    config ENABLE_HARDWARE_LOGFBANK
        bool "Enable HardWare Logfbank"
        depends on !ENABLE_HARDWARE_FFT
        default y

endmenu

#---------------------------------------------------------------------------------#
```

## boards/nationalchip/grus_gx8002_slight_1v/Kconfig
```kconfig
# Voice Signal Preprocess
# Copyright (C) 2001-2020 NationalChip Co., Ltd
# ALL RIGHTS RESERVED!
#
# Kconfig
#
#
#---------------------------------------------------------------------------------#

if BOARD_GX8002_SLIGHT_V1

config BOARD_MODEL
    default "grus_gx8002_slight_1v"

config BOARD_VENDOR
    default "nationalchip"

config SYS_CONFIG_NAME
    default "grus_gx8002_slight_1v"

#-------------------------------------------------#
# Board Version

choice
    prompt "Board version selects: "

    config BOARD_GX8002_SLIGHT_4KEY_1V0
        bool "SLIGHT_4KEY_1V0"
    config BOARD_GX8002_SLIGHT_6KEY_1V0
        bool "SLIGHT_6KEY_1V0"

endchoice

#-------------------------------------------------#
# MIC Number Setting
config BOARD_MIC_NUM
    default 1

#-------------------------------------------------#
config LVP_BUFFER_HAS_MIC
    default y

config LVP_BUFFER_HAS_REF
    default n

config LVP_BUFFER_HAS_FFT
    default n

config LVP_BUFFER_HAS_LOGFBANK
    default y

config LVP_BUFFER_HAS_OUTPUT
    default n

config LVP_HAS_STANDBY
    default y

endif


#---------------------------------------------------------------------------------#
```

## boards/nationalchip/grus_gx8002a_fan_1v/Kconfig
```kconfig
# Voice Signal Preprocess
# Copyright (C) 2001-2020 NationalChip Co., Ltd
# ALL RIGHTS RESERVED!
#
# Kconfig
#
#
#---------------------------------------------------------------------------------#

if BOARD_GX8002A_FAN_V1

config BOARD_MODEL
    default "grus_gx8002a_fan_1v"

config BOARD_VENDOR
    default "nationalchip"

config SYS_CONFIG_NAME
    default "grus_gx8002a_fan_1v"

#-------------------------------------------------#
# Board Version

choice
    prompt "Board version selects: "

    config BOARD_GX8002A_FAN_1V0
        bool "V1.0"

endchoice

#-------------------------------------------------#
# MIC Number Setting
config BOARD_MIC_NUM
    default 1

#-------------------------------------------------#
config LVP_BUFFER_HAS_MIC
    default y

config LVP_BUFFER_HAS_REF
    default n

config LVP_BUFFER_HAS_FFT
    default n

config LVP_BUFFER_HAS_LOGFBANK
    default y

config LVP_BUFFER_HAS_OUTPUT
    default n

config LVP_HAS_STANDBY
    default y

endif

#---------------------------------------------------------------------------------#
```
