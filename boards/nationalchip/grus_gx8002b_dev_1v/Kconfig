## boards/nationalchip/grus_gx8002b_dev_1v/Kconfig
```kconfig
# Voice Signal Preprocess
# Copyright (C) 2001-2020 NationalChip Co., Ltd
# ALL RIGHTS RESERVED!
#
# Kconfig
#---------------------------------------------------------------------------------#

if BOARD_GX8002B_DEV_V1

config BOARD_MODEL
    default "grus_gx8002b_dev_1v"

config BOARD_VENDOR
    default "nationalchip"

config SYS_CONFIG_NAME
    default "grus_gx8002b_dev_1v"

#-------------------------------------------------#
# Board Version

choice
    prompt "Board version selects: "

    config BOARD_GX8002B_DEV_1V0
        bool "V1.0"

endchoice
menu "Board Options: "
comment "This Options depend PIN`s Function"
comment "some options may be conflict             -WATCH OUT!-"
comment "Select what you want"
comment "-----------------------------------------------------"

if BOARD_GX8002B_DEV_1V0

    config BOARD_NO_DMIC
        bool "Disable DMIC"
        default n
        if !BOARD_NO_DMIC
            config BOARD_PDM_SLAVE
            bool "Set PDM SLAVE"
        endif

    config BOARD_HAS_JTAG
        bool "Support JTAG"
        default n

    config BOARD_HAS_I2C0
        bool "Support I2C0"
        default n

    config BOARD_HAS_HW_I2C
        bool "Support HW I2C"
        default n

    config BOARD_HAS_I2C1
        bool "Support I2C1"
        default n

    menuconfig BOARD_HAS_UART0
        bool "Support UART0"
        default n
        if BOARD_HAS_UART0
            config BOARD_HAS_UART0_JUST_SUPPORT_PRINTF_LOG
                bool "Just for print log"
                default n
        endif

    menuconfig BOARD_HAS_UART1
        bool "Support UART1"
        default y
        if BOARD_HAS_UART1
            config BOARD_HAS_UART1_JUST_SUPPORT_PRINTF_LOG
                bool "Just for print log"
                default n
        endif

    config BOARD_HAS_DAC_OUT
        bool "Support DAC out"
        default n

    config BOARD_HAS_SPI_MASTER
        bool "Support SPI MASTER"
        default n

    config BOARD_HAS_SPI_SLAVE
        bool "Support SPI SLAVE"
        default n

    config BOARD_HAS_AIN_I2S_MASTER
        bool "Support AudioIn I2S IN Master mode"
        default n

    config BOARD_HAS_AIN_I2S_SLAVE
        bool "Support AudioIn I2S IN Slave mode"
        default n

    config BOARD_HAS_AIN_I2S_OUT_MASTER
        bool "Support AudioIn I2S Out Master mode"
        default n

    config BOARD_HAS_AIN_I2S_OUT_SLAVE
        bool "Support AudioIn I2S Out Slave mode"
        default n

    config BOARD_HAS_I2S_FIVE_WIRE_MODE
        bool "Support I2S five wire mode, audio in I2S master + audio out I2S slave"
        default n

    config BOARD_HAS_AOUT_I2S_M
        bool "Support AudioOut I2S Master"
        default n

    config BOARD_HAS_AOUT_I2S_S
        bool "Support AudioOut I2S Slave"
        default n

comment "-----------------------------------------------------"

    config BOARD_MIC_GAIN_A
        int "Mic gain (pga), See help for details "
        default 24
        range 0 48
        help
            0-18dB，Step 6dB; 19-48dB，Step 1dB

    config BOARD_MIC_GAIN_B
        int "Mic gain (AudioIn), See help for details "
        default 0
        range 0 9
        help
            0-9 mapping 0-54dB, Step 6dB

endif
endmenu

#-------------------------------------------------#
# MIC Number Setting
config BOARD_MIC_NUM
    default 1

#-------------------------------------------------#
config LVP_BUFFER_HAS_MIC
    default y

config LVP_BUFFER_HAS_REF
    default n

config LVP_BUFFER_HAS_FFT
    default y

config LVP_BUFFER_HAS_LOGFBANK
    default y

config LVP_BUFFER_HAS_OUTPUT
    default n

config LVP_HAS_STANDBY
    default y

config LVP_HAS_G_SENSOR
    default y

config LVP_GSENSOR_USE_SPI
    bool
    default y

config LVP_GSENSOR_USE_I2C
    bool
    default n
endif

#---------------------------------------------------------------------------------#
```

## boards/nationalchip/grus_gx8002b_smartdog_1v/Kconfig
```kconfig
# Voice Signal Preprocess
# Copyright (C) 2001-2021 NationalChip Co., Ltd
# ALL RIGHTS RESERVED!
#
# Kconfig
#---------------------------------------------------------------------------------#

if BOARD_GX8002B_SMARTDOG_V1

config BOARD_MODEL
    default "grus_gx8002b_smartdog_1v"

config BOARD_VENDOR
    default "nationalchip"

config SYS_CONFIG_NAME
    default "grus_gx8002b_smartdog_1v"

#-------------------------------------------------#
# Board Version

choice
    prompt "Board version selects: "

    config BOARD_GX8002B_SMARTDOG_1V1
        bool "V1.1"
    config BOARD_GX8002B_SMARTDOG_1V2
        bool "V1.2"

endchoice
menu "Board Options: "
comment "This Options depend PIN`s Function"
comment "some options may be conflict             -WATCH OUT!-"
comment "Select what you want"
comment "-----------------------------------------------------"

if BOARD_GX8002B_SMARTDOG_1V1 || BOARD_GX8002B_SMARTDOG_1V2

    config BOARD_NO_DMIC
        bool "Disable DMIC"
        default n

    config BOARD_HAS_JTAG
        bool "Support JTAG"
        default n

    config BOARD_HAS_I2C0
        bool "Support I2C0"
        default n

    config BOARD_HAS_HW_I2C
        bool "Support HW I2C"
        default n

    config BOARD_HAS_I2C1
        bool "Support I2C1"
        default n

    menuconfig BOARD_HAS_UART0
        bool "Support UART0"
        default n
        if BOARD_HAS_UART0
            config BOARD_HAS_UART0_JUST_SUPPORT_PRINTF_LOG
                bool "Just for print log"
                default n
        endif

    menuconfig BOARD_HAS_UART1
        bool "Support UART1"
        default y
        if BOARD_HAS_UART1
            config BOARD_HAS_UART1_JUST_SUPPORT_PRINTF_LOG
                bool "Just for print log"
                default n
        endif

    config BOARD_HAS_DAC_OUT
        bool "Support DAC out"
        default n

    config BOARD_HAS_SPI_MASTER
        bool "Support SPI MASTER"
        default n

    config BOARD_HAS_SPI_SLAVE
        bool "Support SPI SLAVE"
        default n

    config BOARD_HAS_AIN_I2S_MASTER
        bool "Support AudioIn I2S IN Master mode"
        default n

    config BOARD_HAS_AIN_I2S_SLAVE
        bool "Support AudioIn I2S IN Slave mode"
        default n

    config BOARD_HAS_AIN_I2S_OUT_MASTER
        bool "Support AudioIn I2S Out Master mode"
        default n

    config BOARD_HAS_AIN_I2S_OUT_SLAVE
        bool "Support AudioIn I2S Out Slave mode"
        default n

    config BOARD_HAS_I2S_FIVE_WIRE_MODE
        bool "Support I2S five wire mode, audio in I2S master + audio out I2S slave"
        default n

    config BOARD_HAS_AOUT_I2S_M
        bool "Support AudioOut I2S Master"
        default n

    config BOARD_HAS_AOUT_I2S_S
        bool "Support AudioOut I2S Slave"
        default n
endif
endmenu

#-------------------------------------------------#
# MIC Number Setting
config BOARD_MIC_NUM
    default 1

#-------------------------------------------------#
config LVP_BUFFER_HAS_MIC
    default y

config LVP_BUFFER_HAS_REF
    default n

config LVP_BUFFER_HAS_FFT
    default y

config LVP_BUFFER_HAS_LOGFBANK
    default y

config LVP_BUFFER_HAS_OUTPUT
    default n

config LVP_HAS_STANDBY
    default y

endif

#---------------------------------------------------------------------------------#
```

## boards/nationalchip/grus_gx8002c_dev_1v/Kconfig
```kconfig
# Voice Signal Preprocess
# Copyright (C) 2001-2021 NationalChip Co., Ltd
# ALL RIGHTS RESERVED!
#
# Kconfig
#---------------------------------------------------------------------------------#

if BOARD_GX8002C_DEV_V1

config BOARD_MODEL
    default "grus_gx8002c_dev_1v"

config BOARD_VENDOR
    default "nationalchip"

config SYS_CONFIG_NAME
    default "grus_gx8002c_dev_1v"

#-------------------------------------------------#
# Board Version

choice
    prompt "Board version selects: "

    config BOARD_GX8002C_DEV_1V0
        bool "V1.0"

endchoice
menu "Board Options: "
comment "This Options depend PIN`s Function"
comment "some options may be conflict             -WATCH OUT!-"
comment "Select what you want"
comment "-----------------------------------------------------"

if BOARD_GX8002C_DEV_1V0

    config BOARD_NO_DMIC
        bool "Disable DMIC"
        default n

    config BOARD_HAS_JTAG
        bool "Support JTAG"
        default n

    config BOARD_HAS_I2C0
        bool "Support I2C0"
        default n

    config BOARD_HAS_HW_I2C
        bool "Support HW I2C"
        default n

    config BOARD_HAS_I2C1
        bool "Support I2C1"
        default n

    menuconfig BOARD_HAS_UART0
        bool "Support UART0"
        default n
        if BOARD_HAS_UART0
            config BOARD_HAS_UART0_JUST_SUPPORT_PRINTF_LOG
                bool "Just for print log"
                default n
        endif

    menuconfig BOARD_HAS_UART1
        bool "Support UART1"
        default y
        if BOARD_HAS_UART1
            config BOARD_HAS_UART1_JUST_SUPPORT_PRINTF_LOG
                bool "Just for print log"
                default n
        endif

    config BOARD_HAS_SPI
        bool "Support SPI"
        default n

    config BOARD_HAS_AIN_I2S_MASTER
        bool "Support AudioIn Master mode"
        default n

    config BOARD_HAS_AIN_I2S_SLAVE
        bool "Support AudioIn Slave mode"
        default n

    config BOARD_HAS_I2S_FIVE_WIRE_MODE
        bool "Support I2S five wire mode, audio in I2S master + audio out I2S slave"
        default n

    config BOARD_HAS_AOUT_I2S_M
        bool "Support AudioOut I2S Master"
        default n

    config BOARD_HAS_AOUT_I2S_S
        bool "Support AudioOut I2S Slave"
        default n
endif
endmenu

#-------------------------------------------------#
# MIC Number Setting
config BOARD_MIC_NUM
    default 1

#-------------------------------------------------#
config LVP_BUFFER_HAS_MIC
    default y

config LVP_BUFFER_HAS_REF
    default n

config LVP_BUFFER_HAS_FFT
    default y

config LVP_BUFFER_HAS_LOGFBANK
    default y

config LVP_BUFFER_HAS_OUTPUT
    default n

config LVP_HAS_STANDBY
    default y

config LVP_HAS_G_SENSOR
    default y

config LVP_GSENSOR_USE_SPI
    bool
    default y

config LVP_GSENSOR_USE_I2C
    bool
    default n
endif

#---------------------------------------------------------------------------------#
```

## boards/nationalchip/grus_gx8002t_test_1v/Kconfig
```kconfig
# Voice Signal Preprocess
# Copyright (C) 2001-2020 NationalChip Co., Ltd
# ALL RIGHTS RESERVED!
#
# Kconfig
#---------------------------------------------------------------------------------#

if BOARD_GX8002T_TEST_V1

config BOARD_MODEL
    default "grus_gx8002t_test_1v"

config BOARD_VENDOR
    default "nationalchip"

config SYS_CONFIG_NAME
    default "grus_gx8002t_test_1v"

#-------------------------------------------------#
# MIC Number Setting
config BOARD_MIC_NUM
    default 1

#-------------------------------------------------#
config LVP_BUFFER_HAS_MIC
    default y

config LVP_BUFFER_HAS_REF
    default n

config LVP_BUFFER_HAS_FFT
    default n

config LVP_BUFFER_HAS_LOGFBANK
    default y

config LVP_BUFFER_HAS_OUTPUT
    default n

config LVP_HAS_STANDBY
    default y

config LVP_HAS_G_SENSOR
    default n

endif

#---------------------------------------------------------------------------------#
```

## drivers_lib/audio_in/Kconfig
```kconfig
menuconfig GX_AUDIO_IN
    bool "AudioIn Support"
    default n
    help
      If you say Y here, you will enable support for Ain driver.

if GX_AUDIO_IN
config GX_AUDIO_IN_VERSION
	string
	default "v1.0" if (ARCH_LEO) || (ARCH_LEO_MINI)
	default "v2.0" if (ARCH_GRUS)
	default "v3.0" if (ARCH_AQUILA_AUDIO)

config GX_AUDIO_IN_DEBUG
    bool "Debug Support for Audio In driver"
    default n
    help
      If you enable Ain Debug option, it will print some important message.

config GX_AUDIO_IN_TEST
    bool "Audio In Test Case"
    default n
    select I2C
    select CMD_AUDIO_IN
    help
      If you say Y here, you will enable support for Ain driver test demo.

config GX_AUDIO_IN_V1
    bool

config GX_AUDIO_IN_V2
    bool
    depends on GX_AUDIO_IN_VERSION="v2.0"
    select GX_ANALOG
    select GX_ANALOG_ADC
    select GX_I2S
    default y

config GX_AUDIO_IN_V3
    bool
    depends on GX_AUDIO_IN_VERSION="v3.0"

endif #GX_AUDIO_IN

menuconfig GX_AUDIO_IN_LITE
    bool "AudioIn Lite Supprot"
	default n
    depends on GX_AUDIO_IN_VERSION="v3.0"

if GX_AUDIO_IN_LITE
config GX_AUDIO_IN_LITE_TEST
	bool "Audio In Lite Test Case"
	default n
	select CMD_AUDIO_IN_LITE
	help
		If you say Y here, you will enable support for Ain driver test demo.
endif
```
