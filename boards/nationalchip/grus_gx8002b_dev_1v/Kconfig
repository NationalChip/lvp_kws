## lvp/vui/kws/Kconfig
```kconfig
#
# Grus
# Copyright (C) 2001-2020 NationalChip Co., Ltd
# ALL RIGHTS RESERVED!
#
# Kconfig: Gurs Kconfig
#---------------------------------------------------------------------------------#

# Public Model Values
config KWS_SNPU_BUFFER_SIZE
    int

config KWS_MODEL_FEATURES_DIM_PER_FRAME
    int

config KWS_MODEL_INPUT_STRIDE_LENGTH
    int

config KWS_MODEL_INPUT_WIN_LENGTH
    int

config KWS_MODEL_OUTPUT_LENGTH
    int

config KWS_MODEL_SUPPORT_SOFTMAX
    bool

config KWS_MODEL_BEAMSEARCH_AND_LM_ALPHA
    int

config KWS_MODEL_BEAMSEARCH_AND_LM_BETA
    int

config KWS_MODEL_BEAMSEARCH_AND_LM_CUTOFF_TOP_N
    int

config BEAM_SIZE
    int

config PREFIX_CHAR_LENGTH
    int

config LEVENSHTEIN_THRESHOLD
    int

config DIMSIM_THRESHOLD
    int

config NORMAL_CTC_SCORE
    bool

config NPU_TOTAL_SIZE
    int

#---------------------------------------------------------------------------------#

config ENABLE_CTC_KWS_AND_BUN_KWS_CASCADE
    bool "Enable CTC_KWS and BUN_KWS Dual Model Cascading"
    depends on LVP_ENABLE_CTC_DECODER
    default n
    help
        "Only support to select ctc_decoder"

if ENABLE_CTC_KWS_AND_BUN_KWS_CASCADE
    config LVP_ENTER_MODEL2_THRESHOLD
        int "The Threshold Of Enter Model2"
        default 950
        range 900 1000
        help
            "If the ctc score exceeds this threshold, the judgment of the model2 will not be made;"
endif

choice
    prompt "Keyword Decoder Type"
    default LVP_ENABLE_CTC_DECODER
    config LVP_ENABLE_CTC_DECODER
        bool "CTC Decoder"
    config LVP_ENABLE_CTC_GX_DECODER
        bool "CTC GX Deocder"
    config LVP_ENABLE_CTC_AND_BEAMSEARCH_DECODER
        bool "CTC And Beamsearch Decoder"
    config LVP_ENABLE_BEAMSEARCH_DECODER
        bool "Beamsearch Decoder without CTC"
    config LVP_ENABLE_USER_DECODER
        bool "User Deocder"
    config LVP_ENABLE_MAX_DECODER
        bool "Max Deocder"
endchoice

if LVP_ENABLE_CTC_AND_BEAMSEARCH_DECODER
    config FILTER_LOW_CTC_SCORES_TH_WHEN_BM_IS_FALSE
        int "Filter Low Ctc Scores Threshold When Bm is False(x10)"
        default 0
        range 0 1000
endif

if LVP_ENABLE_MAX_DECODER
    config KWS_MAX_DECODER_WIN_LENGTH
        int "Max Decoder Determines The Active Window Length"
        default 5
        range 5 20
    config MODEL_ACTIVATION_NUMBERS
        int "Max Decoder Activation Requires The Number of Model Activations"
        default 2
        range 1 4
endif

if LVP_ENABLE_CTC_GX_DECODER
    config ENABLE_USED_FOR_ALL_GRUS_FAMILY
        bool "Enable Used For All Grus Family"
        default y
    config ENABLE_DO_NOT_SLEEP_WHEN_AT_WAKE_UP
        bool "Enable Do not sleep when at wake up"
        default y
    config ENABLE_SWITCH_NPU_MODEL_RUN_IN_FLASH_OR_SRAM
        bool "Enable Switch Npu Model Run In Flash Or Sram"
        default n
    config ENABLE_PRINTF_GXDECODER_MEMORY_MONITORING
        bool "Enable GXdecoder Memory Monitoring"
        default n
    config BLANK_THRESHOLD_FOR_CTC_GX_DECODER
        int "Blank Threshold For CTC GX Decoder(x1000)"
        default 900
    source "lvp/vui/kws/gxdecoder/Kconfig"
    comment ""
endif

source "lvp/vui/kws/models/Kconfig"

config ENABLE_CTC_JUDGE_TO_REDUCE_FALSE_ACTIVATION
    bool "Enable CTC Judge To Reduce False Activation"
    default n

comment ""
config VPA_ENABLE_ONLY_PRINTF_SCORE_WITHOUT_ACTIVATE
    bool "Enable Only Printf Score Without Active"
    default n
config VPA_ENABLE_DELAY_TO_DECODE
    bool "Enable Delay To Decode"
    default n
config VPA_DELAY_TO_DECODE_CNT
    int "Delay Count To Decode (ctx)"
    depends on VPA_ENABLE_DELAY_TO_DECODE
    default 2

if LVP_ENABLE_CTC_AND_BEAMSEARCH_DECODER || LVP_ENABLE_BEAMSEARCH_DECODER
    config ENABLE_KWS_LEVEL_DECODER
        bool "Enable Kws Level Decoder"
        default n
    config ENABLE_CLEAR_TOP_KWS_AUDIO
        bool "Enable Clear Top KWS Audio When Top Kws Activation"
        default y
        depends on ENABLE_KWS_LEVEL_DECODER
    comment ""
    source "lvp/vui/kws/lm_models/Kconfig"
endif

if LVP_ENABLE_CTC_DECODER
    config PREFIX_CHAR_LENGTH
        default 8
endif

#---------------------------------------------------------------------------------#
```

## lvp/vui/kws/lm_models/Kconfig
```kconfig
# Voice Signal Preprocess
# Copyright (C) 2001-2019 NationalChip Co., Ltd
# ALL RIGHTS RESERVED!
#
# Kconfig: LM Kconfig
#---------------------------------------------------------------------------------#

menuconfig ENABLE_LANGUAGE_MODEL
    bool "Enable Language Model"
    default y

    if ENABLE_LANGUAGE_MODEL
        source "lvp/vui/kws/lm_models/enable_lm/Kconfig"
    endif

if !ENABLE_LANGUAGE_MODEL
    source "lvp/vui/kws/lm_models/disable_lm/Kconfig"
endif
```

## lvp/vui/kws/lm_models/disable_lm/Kconfig
```kconfig
config KWS_MODEL_BEAMSEARCH_AND_LM_CUTOFF_TOP_N
    default 30

config BEAM_SIZE
    default 3

config PREFIX_CHAR_LENGTH
    default 8

config LEVENSHTEIN_THRESHOLD
    default 20

config DIMSIM_THRESHOLD
    default 100
```

## lvp/vui/kws/lm_models/enable_lm/Kconfig
```kconfig
# Voice Signal Preprocess
# Copyright (C) 2001-2019 NationalChip Co., Ltd
# ALL RIGHTS RESERVED!
#
# Kconfig: LM Kconfig
#---------------------------------------------------------------------------------#

if ENABLE_LANGUAGE_MODEL
    choice
        prompt "Scenes Select:"
        default LVP_LM_SLIGHT
        source "lvp/vui/kws/lm_models/enable_lm/*/lm.name"
    endchoice
    source "lvp/vui/kws/lm_models/enable_lm/*/Kconfig"
endif
```

## lvp/vui/kws/lm_models/enable_lm/ali_iton_curtain/Kconfig
```kconfig
# Voice Signal Preprocess
# Copyright (C) 2001-2022 NationalChip Co., Ltd
# ALL RIGHTS RESERVED!
#
# Kconfig: LM Kconfig
#---------------------------------------------------------------------------------#
if LVP_LM_ALI_ITON_CURTAIN
    choice
        prompt "Language Models select:"
        default LVP_LM_KWS_ALI_ITON_CURTAIN_V0DOT1DOT0_2022_0621
        source "lvp/vui/kws/lm_models/enable_lm/ali_iton_curtain/*/lm_version.name"
    endchoice

    # lm param kconfig
    source "lvp/vui/kws/lm_models/enable_lm/ali_iton_curtain/*/Kconfig"
endif
```

## lvp/vui/kws/lm_models/enable_lm/aoke_curtain/Kconfig
```kconfig
# Voice Signal Preprocess
# Copyright (C) 2001-2021 NationalChip Co., Ltd
# ALL RIGHTS RESERVED!
#
# Kconfig: LM Kconfig
#---------------------------------------------------------------------------------#
if LVP_LM_AOKE_CURTAIN
    choice
        prompt "Language Models select:"
        default LVP_LM_AOKE_CURTAIN_V0DOT1DOT0_2022_0214
        source "lvp/vui/kws/lm_models/enable_lm/aoke_curtain/*/lm_version.name"
    endchoice

    # lm param kconfig
    source "lvp/vui/kws/lm_models/enable_lm/aoke_curtain/*/Kconfig"
endif
```

## lvp/vui/kws/lm_models/enable_lm/aupu_drying_rack/Kconfig
```kconfig
# Voice Signal Preprocess
# Copyright (C) 2001-2019 NationalChip Co., Ltd
# ALL RIGHTS RESERVED!
#
# Kconfig: LM Kconfig
#---------------------------------------------------------------------------------#
if LVP_LM_AUPU_DRYING_RACK
    choice
        prompt "Language Models select:"
        default LVP_LM_AUPU_DRYING_RACK_V0DOT0DOT1_2021_1112
        source "lvp/vui/kws/lm_models/enable_lm/aupu_drying_rack/*/lm_version.name"
    endchoice

    # lm param kconfig
    source "lvp/vui/kws/lm_models/enable_lm/aupu_drying_rack/*/Kconfig"
endif
```

## lvp/vui/kws/lm_models/enable_lm/aupu_remote/Kconfig
```kconfig
# Voice Signal Preprocess
# Copyright (C) 2001-2019 NationalChip Co., Ltd
# ALL RIGHTS RESERVED!
#
# Kconfig: LM Kconfig
#---------------------------------------------------------------------------------#
if LVP_LM_AUPU_REMOTE
    choice
        prompt "Language Models select:"
        default LVP_LM_AUPU_REMOTE_V0DOT0DOT1_2021_0622
        source "lvp/vui/kws/lm_models/enable_lm/aupu_remote/*/lm_version.name"
    endchoice

    # lm param kconfig
    source "lvp/vui/kws/lm_models/enable_lm/aupu_remote/*/Kconfig"
endif
```

## lvp/vui/kws/lm_models/enable_lm/bathroom_heater_demo/Kconfig
```kconfig
# Voice Signal Preprocess
# Copyright (C) 2001-2021 NationalChip Co., Ltd
# ALL RIGHTS RESERVED!
#
# Kconfig: LM Kconfig
#---------------------------------------------------------------------------------#
if LVP_LM_BATHROOM_HEATER_DEMO
    choice
        prompt "Language Models select:"
        default LVP_LM_BATHROOM_HEATER_DEMO_V0DOT0DOT1_2021_1102
        source "lvp/vui/kws/lm_models/enable_lm/bathroom_heater_demo/*/lm_version.name"
    endchoice

    # lm param kconfig
    source "lvp/vui/kws/lm_models/enable_lm/bathroom_heater_demo/*/Kconfig"
endif
```

## lvp/vui/kws/lm_models/enable_lm/curtain_demo/Kconfig
```kconfig
# Voice Signal Preprocess
# Copyright (C) 2001-2021 NationalChip Co., Ltd
# ALL RIGHTS RESERVED!
#
# Kconfig: LM Kconfig
#---------------------------------------------------------------------------------#
if LVP_LM_CURTAIN_DEMO
    choice
        prompt "Language Models select:"
        default LVP_LM_CURTAIN_DEMO_V0DOT0DOT2_2022_0331
        source "lvp/vui/kws/lm_models/enable_lm/curtain_demo/*/lm_version.name"
    endchoice

    # lm param kconfig
    source "lvp/vui/kws/lm_models/enable_lm/curtain_demo/*/Kconfig"
endif
```

## lvp/vui/kws/lm_models/enable_lm/curtain_demo_2/Kconfig
```kconfig
# Voice Signal Preprocess
# Copyright (C) 2001-2022 NationalChip Co., Ltd
# ALL RIGHTS RESERVED!
#
# Kconfig: LM Kconfig
#---------------------------------------------------------------------------------#
if LVP_LM_CURTAIN_DEMO_2
    choice
        prompt "Language Models select:"
        default LVP_LM_KWS_CURTAIN_DEMO_2_V0DOT1DOT0_2022_0621
        source "lvp/vui/kws/lm_models/enable_lm/curtain_demo_2/*/lm_version.name"
    endchoice

    # lm param kconfig
    source "lvp/vui/kws/lm_models/enable_lm/curtain_demo_2/*/Kconfig"
endif
```

## lvp/vui/kws/lm_models/enable_lm/demo_asr/Kconfig
```kconfig
# Voice Signal Preprocess
# Copyright (C) 2001-2019 NationalChip Co., Ltd
# ALL RIGHTS RESERVED!
#
# Kconfig: LM Kconfig
#---------------------------------------------------------------------------------#
if LVP_LM_DEMO_ASR
    choice
        prompt "Language Models select:"
        default LVP_LM_DEMO_ASR_V0DOT0DOT1_2020_1026
        source "lvp/vui/kws/lm_models/enable_lm/demo_asr/*/lm_version.name"
    endchoice

    # lm param kconfig
    source "lvp/vui/kws/lm_models/enable_lm/demo_asr/*/Kconfig"
endif
```

## lvp/vui/kws/lm_models/enable_lm/demo_asr/v0.0.1/Kconfig
```kconfig
if LVP_LM_DEMO_ASR_V0DOT0DOT1_2020_1026
    config KWS_MODEL_BEAMSEARCH_AND_LM_ALPHA
        default 9

    config KWS_MODEL_BEAMSEARCH_AND_LM_BETA
        default 11

    config KWS_MODEL_BEAMSEARCH_AND_LM_CUTOFF_TOP_N
        default 30

    config BEAM_SIZE
        default 1

    config PREFIX_CHAR_LENGTH
        default 6
endif
```

## lvp/vui/kws/lm_models/enable_lm/difu_toilet/Kconfig
```kconfig
# Voice Signal Preprocess
# Copyright (C) 2001-2022 NationalChip Co., Ltd
# ALL RIGHTS RESERVED!
#
# Kconfig: LM Kconfig
#---------------------------------------------------------------------------------#
if LVP_LM_DIFU_TOILET
    choice
        prompt "Language Models select:"
        default LVP_LM_DIFU_TOILET_V0DOT0DOT1_2022_0125
        source "lvp/vui/kws/lm_models/enable_lm/difu_toilet/*/lm_version.name"
    endchoice

    # lm param kconfig
    source "lvp/vui/kws/lm_models/enable_lm/difu_toilet/*/Kconfig"
endif
```

## lvp/vui/kws/lm_models/enable_lm/drying_rack_demo/Kconfig
```kconfig
# Voice Signal Preprocess
# Copyright (C) 2001-2022 NationalChip Co., Ltd
# ALL RIGHTS RESERVED!
#
# Kconfig: LM Kconfig
#---------------------------------------------------------------------------------#
if LVP_LM_DRYING_RACK_DEMO
    choice
        prompt "Language Models select:"
        default LVP_LM_DRYING_RACK_DEMO_V0DOT0DOT3_2022_0401
        source "lvp/vui/kws/lm_models/enable_lm/drying_rack_demo/*/lm_version.name"
    endchoice

    # lm param kconfig
    source "lvp/vui/kws/lm_models/enable_lm/drying_rack_demo/*/Kconfig"
endif
```

## lvp/vui/kws/lm_models/enable_lm/general_helmet/Kconfig
```kconfig
# Voice Signal Preprocess
# Copyright (C) 2001-2021 NationalChip Co., Ltd
# ALL RIGHTS RESERVED!
#
# Kconfig: LM Kconfig
#---------------------------------------------------------------------------------#
if LVP_LM_GENERAL_HELMET
    choice
        prompt "Language Models select:"
        default LVP_LM_GENERAL_HELMEL_V0DOT0DOT1_2021_0423
        source "lvp/vui/kws/lm_models/enable_lm/general_helmet/*/lm_version.name"
    endchoice

    # lm param kconfig
    source "lvp/vui/kws/lm_models/enable_lm/general_helmet/*/Kconfig"
endif
```
