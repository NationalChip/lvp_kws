## lvp/vui/kws/models/alexa/v0.1.8/Kconfig
```kconfig
menu "Model Param Setting:"
    depends on LVP_KWS_ALEXA_V0DOT1DOT8_2020_1020

    config KWS_MODEL_SUPPORT_SOFTMAX
      default y
    # Byte
    config KWS_SNPU_BUFFER_SIZE
        default 2200

    # Frames
    config KWS_MODEL_FEATURES_DIM_PER_FRAME
        default 40

    config KWS_MODEL_INPUT_STRIDE_LENGTH
        default 4

    config KWS_MODEL_INPUT_WIN_LENGTH
        default 11

    config KWS_MODEL_OUTPUT_LENGTH
        default 42

    config KWS_MODEL_DECODER_STRIDE_LENGTH
        int "KWS Lantency (unit of Context)"
        default 1
        range 1 4

    config KWS_MODEL_DECODER_WIN_LENGTH
        int "KWS Model Decoder Window Length (unit of context)"
        default 25
endmenu
```

## lvp/vui/kws/models/alexa/v0.3.5/Kconfig
```kconfig
menu "Model Param Setting:"
    depends on LVP_KWS_ALEXA_V0DOT3DOT5_2022_1216
    config NORMAL_CTC_SCORE
      default y

    config KWS_MODEL_SUPPORT_SOFTMAX
      default y
    # Byte
    config KWS_SNPU_BUFFER_SIZE
        default 9796

    # Frames
    config KWS_MODEL_FEATURES_DIM_PER_FRAME
        default 40

    config KWS_MODEL_INPUT_STRIDE_LENGTH
        default 4

    config KWS_MODEL_INPUT_WIN_LENGTH
        default 13

    config KWS_MODEL_OUTPUT_LENGTH
        default 13

    config KWS_MODEL_DECODER_STRIDE_LENGTH
        int "KWS Lantency (unit of Context)"
        default 1
        range 1 4

    config KWS_MODEL_DECODER_WIN_LENGTH
        int "KWS Model Decoder Window Length (unit of context)"
        default 25
endmenu
```

## lvp/vui/kws/models/grus_tws_zh/v0.2.1/Kconfig
```kconfig
menu "Model Param Setting:"
    depends on LVP_KWS_GRUS_TWS_ZH_V0DOT2DOT1_2021_0720
    config NORMAL_CTC_SCORE
      default n

    config KWS_MODEL_SUPPORT_SOFTMAX
      default y
    # Byte
    config KWS_SNPU_BUFFER_SIZE
        default 2996

    # Frames
    config KWS_MODEL_FEATURES_DIM_PER_FRAME
        default 40

    config KWS_MODEL_INPUT_STRIDE_LENGTH
        default 4

    config KWS_MODEL_INPUT_WIN_LENGTH
        default 15

    config KWS_MODEL_OUTPUT_LENGTH
        default 65

    config KWS_MODEL_DECODER_STRIDE_LENGTH
        int "KWS Lantency (unit of Context)"
        default 1
        range 1 4

    config KWS_MODEL_DECODER_WIN_LENGTH
        int "KWS Model Decoder Window Length (unit of context)"
        default 25
endmenu
```

## lvp/vui/kws/models/grus_tws_zh/v0.2.1_v0.1.9_hybrid/Kconfig
```kconfig
menu "Model Param Setting:"
    depends on LVP_KWS_GRUS_TWS_ZH_V0DOT2DOT1_V0DOT1DOT9_2021_0722
    config NORMAL_CTC_SCORE
      default y

    config KWS_MODEL_SUPPORT_SOFTMAX
      default y
    # Byte
    config KWS_SNPU_BUFFER_SIZE
        default 2996

    # Frames
    config KWS_MODEL_FEATURES_DIM_PER_FRAME
        default 40

    config KWS_MODEL_INPUT_STRIDE_LENGTH
        default 4

    config KWS_MODEL_INPUT_WIN_LENGTH
        default 15

    config KWS_MODEL_OUTPUT_LENGTH
        default 65

    config KWS_TYPE_HYBRID
        bool
        default y

    config KWS_MODEL_DECODER_STRIDE_LENGTH
        int "KWS Lantency (unit of Context)"
        default 1
        range 1 4

    config KWS_MODEL_DECODER_WIN_LENGTH
        int "KWS Model Decoder Window Length (unit of context)"
        default 25
endmenu
```
