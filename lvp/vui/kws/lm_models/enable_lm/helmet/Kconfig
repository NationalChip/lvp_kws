## lvp/vui/kws/lm_models/enable_lm/helmet/Kconfig
```kconfig
# Voice Signal Preprocess
# Copyright (C) 2001-2019 NationalChip Co., Ltd
# ALL RIGHTS RESERVED!
#
# Kconfig: LM Kconfig
#---------------------------------------------------------------------------------#
if LVP_LM_HELMET
    choice
        prompt "Language Models select:"
        default LVP_LM_HELMEL_V0DOT0DOT2_2021_0304
        source "lvp/vui/kws/lm_models/enable_lm/helmet/*/lm_version.name"
    endchoice

    # lm param kconfig
    source "lvp/vui/kws/lm_models/enable_lm/helmet/*/Kconfig"
endif
```

## lvp/vui/kws/lm_models/enable_lm/helmet/v0.0.2/Kconfig
```kconfig
if LVP_LM_HELMEL_V0DOT0DOT2_2021_0304
    config KWS_MODEL_BEAMSEARCH_AND_LM_ALPHA
        default 9

    config KWS_MODEL_BEAMSEARCH_AND_LM_BETA
        default 11

    config KWS_MODEL_BEAMSEARCH_AND_LM_CUTOFF_TOP_N
        default 10

    menu "LM Model Param Setting:"
        config BEAM_SIZE
            int "BeamSearch Size"
            default 3

        config PREFIX_CHAR_LENGTH
            int "BeamSearch Prefix Char Length"
            default 8

        config LEVENSHTEIN_THRESHOLD
            int "Levenshtein Threshold (x100)"
            default 20

        config DIMSIM_THRESHOLD
            int "Dimsim Threshold (x100)"
            default 100
    endmenu
endif
```

## lvp/vui/kws/lm_models/enable_lm/huawei_watch/Kconfig
```kconfig
# Voice Signal Preprocess
# Copyright (C) 2001-2019 NationalChip Co., Ltd
# ALL RIGHTS RESERVED!
#
# Kconfig: LM Kconfig
#---------------------------------------------------------------------------------#
if LVP_LM_HUAWEI_WATCH
    choice
        prompt "Language Models select:"
        default LVP_LM_HUAWEI_WATCH_V0DOT0DOT1_2020_1110
        source "lvp/vui/kws/lm_models/enable_lm/huawei_watch/*/lm_version.name"
    endchoice

    # lm param kconfig
    source "lvp/vui/kws/lm_models/enable_lm/huawei_watch/*/Kconfig"
endif
```

## lvp/vui/kws/lm_models/enable_lm/huawei_watch/v0.0.1/Kconfig
```kconfig
if LVP_LM_HUAWEI_WATCH_V0DOT0DOT1_2020_1110
    config KWS_MODEL_BEAMSEARCH_AND_LM_ALPHA
        default 9

    config KWS_MODEL_BEAMSEARCH_AND_LM_BETA
        default 11

    config KWS_MODEL_BEAMSEARCH_AND_LM_CUTOFF_TOP_N
        default 30

    config BEAM_SIZE
        default 3

    config PREFIX_CHAR_LENGTH
        default 8

    config LEVENSHTEIN_THRESHOLD
        default 800

    config DIMSIM_THRESHOLD
        default 100
endif
```

## lvp/vui/kws/lm_models/enable_lm/integrated_ceiling/Kconfig
```kconfig
# Voice Signal Preprocess
# Copyright (C) 2001-2022 NationalChip Co., Ltd
# ALL RIGHTS RESERVED!
#
# Kconfig: LM Kconfig
#---------------------------------------------------------------------------------#
if LVP_LM_INTEGRATED_CEILING
    choice
        prompt "Language Models select:"
        default LVP_LM_INTEGRATED_CEILING_V0DOT0DOT1_2022_0507
        source "lvp/vui/kws/lm_models/enable_lm/integrated_ceiling/*/lm_version.name"
    endchoice

    # lm param kconfig
    source "lvp/vui/kws/lm_models/enable_lm/integrated_ceiling/*/Kconfig"
endif
```

## lvp/vui/kws/lm_models/enable_lm/jingyi_curtain/Kconfig
```kconfig
# Voice Signal Preprocess
# Copyright (C) 2001-2021 NationalChip Co., Ltd
# ALL RIGHTS RESERVED!
#
# Kconfig: LM Kconfig
#---------------------------------------------------------------------------------#
if LVP_LM_JINGYI_CURTAIN
    choice
        prompt "Language Models select:"
        default LVP_LM_JINGYI_CURTAIN_V0DOT0DOT2_2022_0331
        source "lvp/vui/kws/lm_models/enable_lm/jingyi_curtain/*/lm_version.name"
    endchoice

    # lm param kconfig
    source "lvp/vui/kws/lm_models/enable_lm/jingyi_curtain/*/Kconfig"
endif
```

## lvp/vui/kws/lm_models/enable_lm/jingyi_drying_rack/Kconfig
```kconfig
# Voice Signal Preprocess
# Copyright (C) 2001-2022 NationalChip Co., Ltd
# ALL RIGHTS RESERVED!
#
# Kconfig: LM Kconfig
#---------------------------------------------------------------------------------#
if LVP_LM_JINGYI_DRYING_RACK
    choice
        prompt "Language Models select:"
        default LVP_LM_JINGYI_DRYING_RACK_V0DOT3DOT0_2022_0902
        source "lvp/vui/kws/lm_models/enable_lm/jingyi_drying_rack/*/lm_version.name"
    endchoice

    # lm param kconfig
    source "lvp/vui/kws/lm_models/enable_lm/jingyi_drying_rack/*/Kconfig"
endif
```

## lvp/vui/kws/lm_models/enable_lm/jingyi_projection_screen/Kconfig
```kconfig
# Voice Signal Preprocess
# Copyright (C) 2001-2019 NationalChip Co., Ltd
# ALL RIGHTS RESERVED!
#
# Kconfig: LM Kconfig
#---------------------------------------------------------------------------------#
if LVP_LM_JINGYI_PROJECTION_SCREEN
    choice
        prompt "Language Models select:"
        default LVP_LM_JINGYI_PROJECTION_SCREEN_V0DOT0DOT1_2021_1214
        source "lvp/vui/kws/lm_models/enable_lm/jingyi_projection_screen/*/lm_version.name"
    endchoice

    # lm param kconfig
    source "lvp/vui/kws/lm_models/enable_lm/jingyi_projection_screen/*/Kconfig"
endif
```

## lvp/vui/kws/lm_models/enable_lm/mezic_heating_table/Kconfig
```kconfig
# Voice Signal Preprocess
# Copyright (C) 2001-2019 NationalChip Co., Ltd
# ALL RIGHTS RESERVED!
#
# Kconfig: LM Kconfig
#---------------------------------------------------------------------------------#
if LVP_LM_MEZIC_HEATING_TABLE
    choice
        prompt "Language Models select:"
        default LVP_LM_MEZIC_HEATING_TABLE_V0DOT0DOT1_2021_0423
        source "lvp/vui/kws/lm_models/enable_lm/mezic_heating_table/*/lm_version.name"
    endchoice

    # lm param kconfig
    source "lvp/vui/kws/lm_models/enable_lm/mezic_heating_table/*/Kconfig"
endif
```

## lvp/vui/kws/lm_models/enable_lm/mezic_jomoo_drying_rack/Kconfig
```kconfig
# Voice Signal Preprocess
# Copyright (C) 2001-2019 NationalChip Co., Ltd
# ALL RIGHTS RESERVED!
#
# Kconfig: LM Kconfig
#---------------------------------------------------------------------------------#
if LVP_LM_MEZIC_JOMOO_DRYING_RACK
    choice
        prompt "Language Models select:"
        default LVP_LM_MEZIC_JOMOO_DRYING_RACK_V0DOT0DOT1_2021_0423
        source "lvp/vui/kws/lm_models/enable_lm/mezic_jomoo_drying_rack/*/lm_version.name"
    endchoice

    # lm param kconfig
    source "lvp/vui/kws/lm_models/enable_lm/mezic_jomoo_drying_rack/*/Kconfig"
endif
```

## lvp/vui/kws/lm_models/enable_lm/mike_bathroom_heater/Kconfig
```kconfig
# Voice Signal Preprocess
# Copyright (C) 2001-2021 NationalChip Co., Ltd
# ALL RIGHTS RESERVED!
#
# Kconfig: LM Kconfig
#---------------------------------------------------------------------------------#
if LVP_LM_MIKE_BATHROOM_HEATER
    choice
        prompt "Language Models select:"
        default LVP_LM_MIKE_BATHROOM_HEATER_V0DOT0DOT1_2021_1102
        source "lvp/vui/kws/lm_models/enable_lm/mike_bathroom_heater/*/lm_version.name"
    endchoice

    # lm param kconfig
    source "lvp/vui/kws/lm_models/enable_lm/mike_bathroom_heater/*/Kconfig"
endif
```

## lvp/vui/kws/lm_models/enable_lm/projection_screen_demo/Kconfig
```kconfig
# Voice Signal Preprocess
# Copyright (C) 2001-2019 NationalChip Co., Ltd
# ALL RIGHTS RESERVED!
#
# Kconfig: LM Kconfig
#---------------------------------------------------------------------------------#
if LVP_LM_PROJECTION_SCREEN_DEMO
    choice
        prompt "Language Models select:"
        default LVP_LM_PROJECTION_SCREEN_DEMO_V0DOT0DOT1_2021_1214
        source "lvp/vui/kws/lm_models/enable_lm/projection_screen_demo/*/lm_version.name"
    endchoice

    # lm param kconfig
    source "lvp/vui/kws/lm_models/enable_lm/projection_screen_demo/*/Kconfig"
endif
```

## lvp/vui/kws/lm_models/enable_lm/qcy_headset/Kconfig
```kconfig
# Voice Signal Preprocess
# Copyright (C) 2001-2019 NationalChip Co., Ltd
# ALL RIGHTS RESERVED!
#
# Kconfig: LM Kconfig
#---------------------------------------------------------------------------------#
if LVP_LM_QCY_HEADSET
    choice
        prompt "Language Models select:"
        default LVP_LM_QCY_HEADSET_V0DOT0DOT1_2021_0123
        source "lvp/vui/kws/lm_models/enable_lm/qcy_headset/*/lm_version.name"
    endchoice

    # lm param kconfig
    source "lvp/vui/kws/lm_models/enable_lm/qcy_headset/*/Kconfig"
endif
```

## lvp/vui/kws/lm_models/enable_lm/qcy_headset/v0.0.1/Kconfig
```kconfig
if LVP_LM_QCY_HEADSET_V0DOT0DOT1_2021_0123
    config KWS_MODEL_BEAMSEARCH_AND_LM_ALPHA
        default 9

    config KWS_MODEL_BEAMSEARCH_AND_LM_BETA
        default 11

    config KWS_MODEL_BEAMSEARCH_AND_LM_CUTOFF_TOP_N
        default 10

    menu "LM Model Param Setting:"
        config BEAM_SIZE
            int "BeamSearch Size"
            default 3

        config PREFIX_CHAR_LENGTH
            int "BeamSearch Prefix Char Length"
            default 6

        config LEVENSHTEIN_THRESHOLD
            int "Levenshtein Threshold (x100)"
            default 20

        config DIMSIM_THRESHOLD
            int "Dimsim Threshold (x100)"
            default 100
    endmenu
endif
```

## lvp/vui/kws/lm_models/enable_lm/ruike_bathroom_heater/Kconfig
```kconfig
# Voice Signal Preprocess
# Copyright (C) 2001-2021 NationalChip Co., Ltd
# ALL RIGHTS RESERVED!
#
# Kconfig: LM Kconfig
#---------------------------------------------------------------------------------#
if LVP_LM_RUIKE_BATHROOM_HEATER
    choice
        prompt "Language Models select:"
        default LVP_LM_RUIKE_BATHROOM_HEATER_V0DOT0DOT1_2021_1231
        source "lvp/vui/kws/lm_models/enable_lm/ruike_bathroom_heater/*/lm_version.name"
    endchoice

    # lm param kconfig
    source "lvp/vui/kws/lm_models/enable_lm/ruike_bathroom_heater/*/Kconfig"
endif
```

## lvp/vui/kws/lm_models/enable_lm/slight/Kconfig
```kconfig
# Voice Signal Preprocess
# Copyright (C) 2001-2019 NationalChip Co., Ltd
# ALL RIGHTS RESERVED!
#
# Kconfig: LM Kconfig
#---------------------------------------------------------------------------------#
if LVP_LM_SLIGHT
    choice
        prompt "Language Models select:"
        default LVP_LM_SLIGHT_V0DOT0DOT1_2020_0917
        source "lvp/vui/kws/lm_models/enable_lm/slight/*/lm_version.name"
    endchoice

    # lm param kconfig
    source "lvp/vui/kws/lm_models/enable_lm/slight/*/Kconfig"
endif
```

## lvp/vui/kws/lm_models/enable_lm/slight/v0.0.1/Kconfig
```kconfig
if LVP_LM_SLIGHT_V0DOT0DOT1_2020_0917
    config KWS_MODEL_BEAMSEARCH_AND_LM_ALPHA
        default 9

    config KWS_MODEL_BEAMSEARCH_AND_LM_BETA
        default 11

    config KWS_MODEL_BEAMSEARCH_AND_LM_CUTOFF_TOP_N
        default 30
endif
```

## lvp/vui/kws/lm_models/enable_lm/sunshade_demo/Kconfig
```kconfig
# Voice Signal Preprocess
# Copyright (C) 2001-2019 NationalChip Co., Ltd
# ALL RIGHTS RESERVED!
#
# Kconfig: LM Kconfig
#---------------------------------------------------------------------------------#
if LVP_LM_SUNSHADE_DEMO
    choice
        prompt "Language Models select:"
        default LVP_LM_SUNSHADE_DEMO_V0DOT0DOT1_2021_1029
        source "lvp/vui/kws/lm_models/enable_lm/sunshade_demo/*/lm_version.name"
    endchoice

    # lm param kconfig
    source "lvp/vui/kws/lm_models/enable_lm/sunshade_demo/*/Kconfig"
endif
```

## lvp/vui/kws/lm_models/enable_lm/toilet_demo/Kconfig
```kconfig
# Voice Signal Preprocess
# Copyright (C) 2001-2022 NationalChip Co., Ltd
# ALL RIGHTS RESERVED!
#
# Kconfig: LM Kconfig
#---------------------------------------------------------------------------------#
if LVP_LM_TOILET_DEMO
    choice
        prompt "Language Models select:"
        default LVP_LM_TOILET_DEMO_V0DOT0DOT1_2022_0125
        source "lvp/vui/kws/lm_models/enable_lm/toilet_demo/*/lm_version.name"
    endchoice

    # lm param kconfig
    source "lvp/vui/kws/lm_models/enable_lm/toilet_demo/*/Kconfig"
endif
```

## lvp/vui/kws/lm_models/enable_lm/toilet_demo/v0.0.1/Kconfig
```kconfig
if LVP_LM_TOILET_DEMO_V0DOT0DOT1_2022_0125
    config KWS_MODEL_BEAMSEARCH_AND_LM_ALPHA
        default 9

    config KWS_MODEL_BEAMSEARCH_AND_LM_BETA
        default 11

    config KWS_MODEL_BEAMSEARCH_AND_LM_CUTOFF_TOP_N
        default 30
    menu "LM Model Param Setting:"
        config BEAM_SIZE
            int "BeamSearch Size"
            default 3

        config PREFIX_CHAR_LENGTH
            int "BeamSearch Prefix Char Length"
            default 8

        config LEVENSHTEIN_THRESHOLD
            int "Levenshtein Threshold (x100)"
            default 30

        config DIMSIM_THRESHOLD
            int "Dimsim Threshold (x100)"
            default 100
    endmenu
endif
```

## lvp/vui/kws/lm_models/enable_lm/yongjiu_dryer/Kconfig
```kconfig
# Voice Signal Preprocess
# Copyright (C) 2001-2022 NationalChip Co., Ltd
# ALL RIGHTS RESERVED!
#
# Kconfig: LM Kconfig
#---------------------------------------------------------------------------------#
if LVP_LM_YONGJIU_DRYER
    choice
        prompt "Language Models select:"
        default LVP_LM_YONGJIU_DRYER_V0DOT0DOT1_2022_0125
        source "lvp/vui/kws/lm_models/enable_lm/yongjiu_dryer/*/lm_version.name"
    endchoice

    # lm param kconfig
    source "lvp/vui/kws/lm_models/enable_lm/yongjiu_dryer/*/Kconfig"
endif
```

## lvp/vui/kws/models/Kconfig
```kconfig
# Voice Signal Preprocess
# Copyright (C) 2001-2019 NationalChip Co., Ltd
# ALL RIGHTS RESERVED!
#
# Kconfig: KWS Kconfig
#---------------------------------------------------------------------------------#

choice
    prompt "KeyWord select:"
    default LVP_KWS_XIAO_DU_XIAO_DU

    source "lvp/vui/kws/models/*/kws.name"
endchoice

# kws version list
source "lvp/vui/kws/models/*/kws_version.list"
# kws model param kconfig
source "lvp/vui/kws/models/*/*/Kconfig"
# kws list
source "lvp/vui/kws/models/*/*/kws.list"

if KWS_TYPE_HYBRID
    config KWS_TYPE_HYBRID_SWITCH_BY_ENV_NOISE
        bool "Switch Model by Environment Noise"
        default y
        select ENABLE_PLL_FREQUENCY_HIGH
        select ENABLE_NOISE_JUDGEMENT

    config KWS_TYPE_HYBRID_SWITCH_BY_KWS_STATE
        bool "Switch Model by Kws State"
        default n
endif

choice
    prompt "CTC Score Version"
    default USE_CTC_VERSION_V0DOT0DOT1
    config USE_CTC_VERSION_V0DOT0DOT1
        bool "CTC Score Version V0.1.1"

    config USE_CTC_VERSION_V0DOT0DOT3
        bool "CTC Score Version V0.1.3"
endchoice

config LVP_MODEL_USE_RNN
    bool "Model Use Recurrent Neural Network"
    default y

config LVP_ENABLE_CTC_SCORE_COMPENSATOR
    bool "Enable CTC Score Compensator"
    default n

config LVP_ENABLE_OPTIMIZE_SHORT_INSTRUCTIONS
    bool "Enable Optimize short instructions"
    default n

config LVP_SHORT_INSTRUCTIONS_OFFSET
    int "Short Instruction Offset"
    depends on LVP_ENABLE_OPTIMIZE_SHORT_INSTRUCTIONS
    default 0


config LVP_ENABLE_CTC_BIONIC
    bool "Enable CTC BIONIC To Reduce False Activation"
    default n
    depends on LVP_ENABLE_CTC_DECODER || ENABLE_CTC_KWS_AND_BUN_KWS_CASCADE || LVP_ENABLE_CTC_AND_BEAMSEARCH_DECODER
config LVP_KWS_THRESHOLD_STEP
    int "[CTC] Threshold Step For Bionic(x10)"
    depends on LVP_ENABLE_CTC_BIONIC
    default 5
config LVP_KWS_MAX_THRESHOLD_ADJUSTMENT_VALUE
    int "[CTC] Maximum Threshold Adjustment Value For Bionic(x10)"
    depends on LVP_ENABLE_CTC_BIONIC
    default 20
config LVP_KWS_THRESHOLD_ADJUST_TIME
    int "[CTC] Threshold Adjust time For Bionic(Second)"
    depends on LVP_ENABLE_CTC_BIONIC
    default 500

config LVP_ENABLE_BUNKWS_BIONIC
    bool "Enable Bunkws BIONIC To Reduce False Activation"
    default n
    depends on LVP_ENABLE_MAX_DECODER || ENABLE_CTC_KWS_AND_BUN_KWS_CASCADE
config LVP_BUNKWS_KWS_THRESHOLD_STEP
    int "[BUNKWS] Threshold Step For Bionic(x100)"
    depends on LVP_ENABLE_BUNKWS_BIONIC
    default 5
config LVP_BUNKWS_MAX_THRESHOLD_ADJUSTMENT_VALUE
    int "[BUNKWS] Maximum Threshold Adjustment Value For Bionic(x100)"
    depends on LVP_ENABLE_BUNKWS_BIONIC
    default 40
config LVP_BUNKWS_THRESHOLD_ADJUST_TIME
    int "[BUNKWS] Threshold Adjust time For Bionic(Second)"
    depends on LVP_ENABLE_BUNKWS_BIONIC
    default 1000

#---------------------------------------------------------------------------------#
```
